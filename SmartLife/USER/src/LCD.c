#include "main.h"                 /* 包含lcd头文件 */


/**
  * @brief LCD管脚初始化
  * @param  void
  * @retval void
  * @note   LCD_SDA(PB5), LCD_SCK(PB3), LCD_CS(PB4) 通用推挽输出
  *         LCD_DC(PD3),  LCD_BLK(PD4)               通用推挽输出
  */
void Lcd_Port_Config(void)
{
    /* 打开GPIOB和GPIOD时钟 */
    RCC_AHB1PeriphClockCmd(RCC_AHB1Periph_GPIOB | RCC_AHB1Periph_GPIOD, ENABLE);

    /* IO管脚初始化结构体 */
    GPIO_InitTypeDef GPIO_InitStruct = {0};

    /* PB3(SCK), PB4(CS), PB5(SDA) 配置为推挽输出 */
    GPIO_InitStruct.GPIO_Mode   = GPIO_Mode_OUT;       /* 输出模式 */
    GPIO_InitStruct.GPIO_OType  = GPIO_OType_PP;       /* 推挽输出 */
    GPIO_InitStruct.GPIO_Pin    = GPIO_Pin_3 | GPIO_Pin_4 | GPIO_Pin_5;
    GPIO_InitStruct.GPIO_PuPd   = GPIO_PuPd_NOPULL;    /* 无上下拉 */
    GPIO_InitStruct.GPIO_Speed  = GPIO_Speed_50MHz;    /* 50MHz速度 */
    GPIO_Init(GPIOB, &GPIO_InitStruct);                /* 初始化GPIOB */

    /* PD3(DC), PD4(BLK) 配置为推挽输出 */
	GPIO_InitStruct.GPIO_Mode   = GPIO_Mode_OUT;       /* 输出模式 */
    GPIO_InitStruct.GPIO_OType  = GPIO_OType_PP;       /* 推挽输出 */
    GPIO_InitStruct.GPIO_Pin    = GPIO_Pin_3 | GPIO_Pin_4;
	GPIO_InitStruct.GPIO_PuPd   = GPIO_PuPd_NOPULL;    /* 无上下拉 */
    GPIO_InitStruct.GPIO_Speed  = GPIO_Speed_50MHz;    /* 50MHz速度 */
    GPIO_Init(GPIOD, &GPIO_InitStruct);                /* 初始化GPIOD */

    /* 设置初始电平: CS=高(非选中), BLK=关(背光关闭) */
    LCD_CS_H;                                          /* 片选拉高,不选中LCD */
    LCD_BLK_OFF;                                       /* 背光关闭 */
}

/**
  * @brief LCD发送8bit数据(SPI方式,模式0,高位先出)
  * @param  data  要发送的8bit数据
  * @retval void
  * @note   SPI模式0: SCK空闲低电平,上升沿采样
  *         高位先出: 从bit7开始发送到bit0
  */
void Lcd_TransferData(u8 data)
{
    for(u8 i = 0; i < 8; i++)                          /* 循环8次,每次发送1bit */
    {
        LCD_SCK_L;                                     /* 拉低时钟线,准备发送数据 */
        if(data & (0x80 >> i))                         /* 从高位到低位逐位判断 */
        {
            LCD_SDA_H;                                 /* 该位为1,数据线置高 */
        }
        else
        {
            LCD_SDA_L;                                 /* 该位为0,数据线置低 */
        }
        LCD_SCK_H;                                     /* 拉高时钟线,从机在上升沿采样 */
    }
}

/**
  * @brief LCD发送8bit数据/参数
  * @param  data  要发送的8bit数据/参数
  * @retval void
  * @note   DC置高表示发送数据/参数,CS低有效,结束后CS拉高
  */
void Lcd_Send_Data(u8 data)
{
    LCD_DATA;                                          /* DC置高,选择发送数据/参数 */
    LCD_CS_L;                                          /* 拉低片选,建立通信 */
    Lcd_TransferData(data);                            /* 发送8bit数据 */
    LCD_CS_H;                                          /* 拉高片选,结束通信 */
}

/**
  * @brief LCD发送8bit命令
  * @param  cmd  要发送的命令
  * @retval void
  * @note   DC置低表示发送命令,CS低有效,结束后CS拉高
  */
void Lcd_Send_Cmd(u8 cmd)
{
    LCD_CMD;                                           /* DC置低,选择发送命令 */
    LCD_CS_L;                                          /* 拉低片选,建立通信 */
    Lcd_TransferData(cmd);                             /* 发送8bit命令 */
    LCD_CS_H;                                          /* 拉高片选,结束通信 */
}

/**
  * @brief LCD初始化
  * @param  void
  * @retval void
  * @note   包含GPIO初始化、LCD参数配置和初始化清屏(白色)
  *         寄存器初始化序列:
  *         0x36(0x00) → 0x3A(0x05) → 0xB2(5参数) → 0xB7(0x35)
  *         → 0xBB(0x19) → 0xC0(0x2C) → 0xC2(0x01) → 0xC3(0x12)
  *         → 0xC4(0x20) → 0xC6(0x0F) → 0xD0(2参数) → 0xE0(14gamma)
  *         → 0xE1(14gamma) → 0x21 → 0x11 → 0x29 → 清屏白色
  */
void LCD_Init(void)
{
    /* GPIO管脚初始化 */
    Lcd_Port_Config();                                 /* 初始化LCD控制引脚 */

    /* 打开背光 */
    LCD_BLK_ON;                                        /* 开启LCD背光 */
    delay_ms(100);                                     /* 延时100ms等待背光稳定 */

    /* ************* Start Initial Sequence ********** */
    Lcd_Send_Cmd(0x11);                                /* Sleep Out: 从睡眠模式唤醒 */
    delay_ms(120);                                     /* 延时120ms等待唤醒稳定 */
    /* ************* Start Initial Sequence ********** */

    /* 设置存储地址访问控制: MX=MY=MV=0(正常模式), BGR=1(像素顺序BGR) */
    Lcd_Send_Cmd(0x36);
    Lcd_Send_Data(0x00);

    /* 设置颜色位深: 16bit(65K色), RGB格式为565 */
    Lcd_Send_Cmd(0x3A);
    Lcd_Send_Data(0x05);

    /* 设置列扫描周期等参数 */
    Lcd_Send_Cmd(0xB2);
    Lcd_Send_Data(0x0C);
    Lcd_Send_Data(0x0C);
    Lcd_Send_Data(0x00);
    Lcd_Send_Data(0x33);
    Lcd_Send_Data(0x33);

    /* 设置栅极驱动 */
    Lcd_Send_Cmd(0xB7);
    Lcd_Send_Data(0x35);

    /* 设置VCOM电压 */
    Lcd_Send_Cmd(0xBB);
    Lcd_Send_Data(0x19);

    /* 设置电源控制 */
    Lcd_Send_Cmd(0xC0);
    Lcd_Send_Data(0x2C);

    /* 设置VDV与VRH参数 */
    Lcd_Send_Cmd(0xC2);
    Lcd_Send_Data(0x01);

    /* 设置VRH参数 */
    Lcd_Send_Cmd(0xC3);
    Lcd_Send_Data(0x12);

    /* 设置VDV参数 */
    Lcd_Send_Cmd(0xC4);
    Lcd_Send_Data(0x20);

    /* 设置帧率控制 */
    Lcd_Send_Cmd(0xC6);
    Lcd_Send_Data(0x0F);

    /* 设置电源控制 */
    Lcd_Send_Cmd(0xD0);
    Lcd_Send_Data(0xA4);
    Lcd_Send_Data(0xA1);

    /* 设置Gamma正极校正曲线(14个参数) */
    Lcd_Send_Cmd(0xE0);
    Lcd_Send_Data(0xD0);
    Lcd_Send_Data(0x04);
    Lcd_Send_Data(0x0D);
    Lcd_Send_Data(0x11);
    Lcd_Send_Data(0x13);
    Lcd_Send_Data(0x2B);
    Lcd_Send_Data(0x3F);
    Lcd_Send_Data(0x54);
    Lcd_Send_Data(0x4C);
    Lcd_Send_Data(0x18);
    Lcd_Send_Data(0x0D);
    Lcd_Send_Data(0x0B);
    Lcd_Send_Data(0x1F);
    Lcd_Send_Data(0x23);

    /* 设置Gamma负极校正曲线(14个参数) */
    Lcd_Send_Cmd(0xE1);
    Lcd_Send_Data(0xD0);
    Lcd_Send_Data(0x04);
    Lcd_Send_Data(0x0C);
    Lcd_Send_Data(0x11);
    Lcd_Send_Data(0x13);
    Lcd_Send_Data(0x2C);
    Lcd_Send_Data(0x3F);
    Lcd_Send_Data(0x44);
    Lcd_Send_Data(0x51);
    Lcd_Send_Data(0x2F);
    Lcd_Send_Data(0x1F);
    Lcd_Send_Data(0x1F);
    Lcd_Send_Data(0x20);
    Lcd_Send_Data(0x23);

    /* 开启反相(取色)/正常显示/开启显示 */
    Lcd_Send_Cmd(0x21);                                /* 开启反相显示(取色模式) */
    Lcd_Send_Cmd(0x11);                                /* Sleep Out(再次确保退出睡眠) */
    Lcd_Send_Cmd(0x29);                                /* Display ON: 开启显示 */

    /* 清屏为白色(全屏填充白色) */
    Lcd_Clear(0, 0, 240, 320, 0xFFFF);                 /* 分辨率240x320,填充白色 */
}

/**
  * @brief LCD发送16bit数据(先高8bit后低8bit)
  * @param  data  要发送的16bit数据
  * @retval void
  * @note   先发送高8bit,再发送低8bit,用于颜色数据发送
  */
void Lcd_Send_Data16b(u16 data)
{
    LCD_DATA;                                          /* DC置高,选择发送数据 */
    LCD_CS_L;                                          /* 拉低片选,建立通信 */
    Lcd_TransferData(data >> 8);                       /* 发送高8bit数据 */
    Lcd_TransferData(data);                            /* 发送低8bit数据 */
    LCD_CS_H;                                          /* 拉高片选,结束通信 */
}

/**
  * @brief LCD设置显示范围(设置坐标窗口)
  * @param  xs  X轴起始坐标
  * @param  ys  Y轴起始坐标
  * @param  xe  X轴结束坐标
  * @param  ye  Y轴结束坐标
  * @retval void
  * @note   设置列地址(0x2A),行地址(0x2B),然后发送写帧存储器命令(0x2C)
  */
void Lcd_SetPostion(u16 xs, u16 ys, u16 xe, u16 ye)
{
    /* 设置列地址(X轴) */
    Lcd_Send_Cmd(0x2A);                                /* 发送设置列地址命令 */
    Lcd_Send_Data16b(xs);                              /* 发送X轴起始坐标 */
    Lcd_Send_Data16b(xe - 1);                          /* 发送X轴结束坐标(内部算法:xe-1) */

    /* 设置行地址(Y轴) */
    Lcd_Send_Cmd(0x2B);                                /* 发送设置行地址命令 */
    Lcd_Send_Data16b(ys);                              /* 发送Y轴起始坐标 */
    Lcd_Send_Data16b(ye - 1);                          /* 发送Y轴结束坐标(内部算法:ye-1) */

    /* 发送写帧存储器命令(告诉LCD驱动芯片,接下来发送颜色数据) */
    Lcd_Send_Cmd(0x2C);
}

/**
  * @brief LCD清屏函数(向指定范围填充颜色)
  * @param  xs    X轴起始坐标
  * @param  ys    Y轴起始坐标
  * @param  xe    X轴结束坐标
  * @param  ye    Y轴结束坐标
  * @param  color 填充颜色(16bit,RGB565格式)
  * @retval void
  * @note   先设置显示范围,然后循环往每个像素发送颜色数据
  */
void Lcd_Clear(u16 xs, u16 ys, u16 xe, u16 ye, u16 color)
{
    /* 设置填充颜色范围(挖坑) */
    Lcd_SetPostion(xs, ys, xe, ye);

    /* 往设置范围内每个像素点发送1个16bit颜色数据 */
    for(u32 i = 0; i < (u32)(xe - xs) * (ye - ys); i++)
    {
        Lcd_Send_Data16b(color);                       /* 向当前像素发送颜色数据 */
    }
}

/**
  * @brief LCD画点函数(在指定坐标画一个像素点)
  * @param  x      X轴坐标
  * @param  y      Y轴坐标
  * @param  color  颜色(16bit,RGB565格式)
  * @retval void
  * @note   设置1x1像素点范围,发送颜色数据
  */
void Lcd_DrawPoint(u16 x, u16 y, u16 color)
{
    Lcd_SetPostion(x, y, x + 1, y + 1);    /* 设置1x1像素点范围 */
    Lcd_Send_Data16b(color);                /* 发送颜色数据 */
}

/**
  * @brief LCD显示单个英文字符
  * @param  x           X轴起始坐标
  * @param  y           Y轴起始坐标
  * @param  font_color  字体颜色
  * @param  bg_color    背景颜色
  * @param  size        字体大小   16:8*16     24:12*24    32:16*32
  * @param  eng         指向文字点阵数据
  * @retval void
  * @note   逐行逐bit判断,亮点点前景色,暗点背景色
  *         16号:每字符16字节,每行8个bit
  *         24号:每字符48字节,每行16个bit(2字节)
  *         32号:每字符64字节,每行16个bit(2字节)
  */
void Lcd_DisplayChar(u16 x, u16 y, u16 font_color, u16 bg_color, u8 size, u8 *eng)
{
    u8 i, j, k;                      /* 循环变量 */
    u8 row_size = 0;                 /* 每行字节数 */

    /* 计算每行字节数: 字宽(size/2) / 8 = 每行字节数 */
    row_size = size / 2 / 8;         /* 字宽=size/2, 每字节8bit */
    if(size / 2 % 8 != 0)            /* 如果不能整除,需要加1字节 */
    {
        row_size += 1;               /* 补足1字节 */
    }

    /* 逐行扫描显示 */
    for(i = 0; i < size; i++)        /* 行循环: 一共size行 */
    {
        for(k = 0; k < row_size; k++) /* 每行字节循环 */
        {
            for(j = 0; j < 8; j++)   /* 每字节bit循环(8bit) */
            {
                if(eng[i * row_size + k] & (0x80 >> j))  /* 亮点 */
                {
                    Lcd_DrawPoint(x + j + k * 8, y + i, font_color);
                }
                else                                      /* 暗点 */
                {
                    Lcd_DrawPoint(x + j + k * 8, y + i, bg_color);
                }
            }
        }
    }
}

/**
  * @brief LCD显示字符串(循环调用Lcd_DisplayChar显示一串字符)
  * @param  x           X轴起始坐标
  * @param  y           Y轴起始坐标
  * @param  font_color  字体颜色
  * @param  bg_color    背景颜色
  * @param  size        字体大小   16:8*16     24:12*24    32:16*32
  * @param  str         指向字模数据指针数组的指针(u8 **,每个元素指向一个字符字模)
  * @retval void
  * @note   str参数实际类型为u8 **,指向一个以NULL结尾的字模指针数组
  *         遍历数组直到NULL指针,每个字符依次显示,自动计算x偏移
  *         字号16:字符宽8像素,偏移12(含间距4像素)
  *         字号24:字符宽12像素,偏移16(含间距4像素)
  *         字号32:字符宽16像素,偏移20(含间距4像素)
  */
void Lcd_DisplayString(u16 x, u16 y, u16 font_color, u16 bg_color, u8 size, u8 *str)
{
    u8 i = 0;
    u16 offset_x = 0;
    u8 char_width = 8;
    u8 char_spacing = 4;
    u8 **font_table = (u8 **)str;                        /* 转换为指针数组 */

    /* 根据字号设置字符宽度 */
    if(size == 16)      char_width = 8;
    else if(size == 24) char_width = 12;
    else if(size == 32) char_width = 16;

    /* 遍历字符字模指针数组,直到遇到NULL结束 */
    while(font_table[i] != NULL)
    {
        Lcd_DisplayChar(x + offset_x, y, font_color, bg_color, size, font_table[i]);
        offset_x += char_width + char_spacing;           /* 计算下一个字符的x起始位置 */
        i++;
    }
}

/**
  * @brief LCD显示单个汉字(16x16点阵)
  * @param  x           X轴起始坐标
  * @param  y           Y轴起始坐标
  * @param  font_color  字体颜色
  * @param  bg_color    背景颜色
  * @param  size        字体大小(固定16,仅16x16)
  * @param  chi         指向汉字点阵数据(32字节,16行x2字节/行)
  * @retval void
  * @note   汉字固定使用16x16点阵,每行2字节(16bit),共16行,总计32字节
  *         逐行扫描,每行16bit,判断每个bit是亮还是暗
  *         亮点点前景色,暗点背景色
  */
void Lcd_DisplayChi(u16 x, u16 y, u16 font_color, u16 bg_color, u8 size, u8 *chi)
{
    u8 i, j, k;                      /* 循环变量 */
    u8 row_size = 0;                 /* 每行字节数 */

    /* 计算每行字节数: size / 8 = 每行字节数 */
    row_size = size / 8;             /* 字宽=字高=size, 每字节8bit */

    /* 逐行扫描显示 */
    for(i = 0; i < size; i++)        /* 行循环: 一共size行 */
    {
        for(k = 0; k < row_size; k++) /* 每行字节循环 */
        {
            for(j = 0; j < 8; j++)   /* 每字节bit循环(8bit) */
            {
                if(chi[i * row_size + k] & (0x80 >> j))  /* 亮点 */
                {
                    Lcd_DrawPoint(x + j + k * 8, y + i, font_color);
                }
                else                                      /* 暗点 */
                {
                    Lcd_DrawPoint(x + j + k * 8, y + i, bg_color);
                }
            }
        }
    }
}

/**
  * @brief LCD显示图片函数
  * @param  x   X轴起始坐标
  * @param  y   Y轴起始坐标
  * @param  pic 指向图片数据(图片数据格式: 前6字节为BMP头, pic[2:3]=宽度, pic[4:5]=高度)
  *             从pic[8]开始为RGB565像素数据(每像素2字节)
  * @retval 无
  */
void Lcd_DisplayPic(u16 x, u16 y, u8 *pic)
{
    u16 w, h;                      /* 图片宽度和高度 */
    u32 i;                         /* 循环变量 */

    /* 从图片头数据中获取宽度和高度 */
    w = pic[2] << 8 | pic[3];      /* pic[2]=宽度高8bit, pic[3]=宽度低8bit */
    h = pic[4] << 8 | pic[5];      /* pic[4]=高度高8bit, pic[5]=高度低8bit */

    /* 设置图片显示范围 */
    Lcd_SetPostion(x, y, x + w, y + h);

    /* 开始逐像素填充颜色数据 */
    for(i = 0; i < (u32)w * h; i++)
    {
        /* 从pic[8]开始, 每2字节为一个像素的RGB565颜色数据 */
        Lcd_Send_Data16b(pic[8 + i * 2] << 8 | pic[8 + i * 2 + 1]);
    }
}

/**
  * @brief LCD显示单个汉字（字库版）
  * @param  
            u16 x               X轴起始坐标
            u16 y               Y轴起始坐标
            u16 font_color      字体颜色
            u16 bg_color        背景颜色
            u8  size            字体大小   16:16*16     24：24*24    32:32*32
            u8 *chi             指向文字点阵数据
  * @retval void
  * @author He  
  */

void Lcd_ZikuChi(u16 x,u16 y,u16 font_color,u16 bg_color,u8 size,u8 *chi)
{
    
    u8 i,j,k;
    u8 row_size = 0;//记录一行多少字节数据
    u32 addr = 0;
    u8 buff[512]={0};
    
    row_size = size / 8;
    //1、计算不同大小中文字体字库偏移量(对应ZK.bin文件布局)
    switch(size)
    {
        case 16:addr+=0x00000806;break;   /* HZK16起始偏移 */
        case 24:addr+=0x00041E52;break;   /* HZK24起始偏移 */
        case 32:addr+=0x000D3A6E;break;   /* HZK32起始偏移 */
    }
    //2、计算显示字体数据在字库的偏移量
    addr += ((chi[0]-0xA1)*94 + (chi[1]-0xA1))*row_size*size;
    
    //3、根据计算出来的偏移量（地址），读取W25Q64保存的字模数据
    Read_Data(addr,row_size*size,buff);
    
    for(i=0;i<size;i++)//行
    {
        for(k=0;k<row_size;k++)
        {
          for(j=0;j<8;j++)
          {
             if(buff[i*row_size+k] & (0x80 >> j))
             {
                 Lcd_DrawPoint(x+j+k*8,y+i,font_color);//画亮点
             }
             else
             {
                 Lcd_DrawPoint(x+j+k*8,y+i,bg_color);//画暗点
             }    
          }          
        }
    }
  
}
/**
  * @brief LCD显示单个英文字符（字库版，从W25Q64读取）
  * @param  x               X轴起始坐标
  * @param  y               Y轴起始坐标
  * @param  font_color      字体颜色
  * @param  bg_color        背景颜色
  * @param  size            字体大小   16:8*16    24:12*24    32:16*32
  * @param  code            ASCII字符码(如'A'=65)
  * @retval void
  * @note   从W25Q64字库中读取ASC字模数据后显示
  *         ASC16基地址=0x00000000, ASC24基地址=0x0004064C, ASC32基地址=0x000D1A68
  */
void Lcd_ZikuEng(u16 x, u16 y, u16 font_color, u16 bg_color, u8 size, u8 code)
{
    u8 i, j, k;                          /* 循环变量 */
    u8 row_size = 0;                     /* 每行字节数 */
    u32 addr = 0;                        /* W25Q64字库地址 */
    u8 buff[64] = {0};                   /* 字模数据缓冲区(最大64字节) */

    /* 计算每行字节数: 字宽=size/2, 每字节8bit */
    row_size = size / 2 / 8;             /* 16号:1, 24号:2, 32号:2 */
    if(size / 2 % 8 != 0)                /* 如果不能整除,加1字节 */
    {
        row_size += 1;
    }

    /* 1. 根据字号选择ASC字库基地址 */
    switch(size)
    {
        case 16:  addr += 0x00000000; break;   /* ASC16起始偏移 */
        case 24:  addr += 0x0004064C; break;   /* ASC24起始偏移 */
        case 32:  addr += 0x000D1A68; break;   /* ASC32起始偏移 */
        default:  return;
    }

    /* 2. 计算字符偏移: 每个字符占 row_size * size 字节 */
    addr += (u32)code * row_size * size;

    /* 3. 从W25Q64读取字模数据 */
    Read_Data(addr, row_size * size, buff);

    /* 4. 逐行逐bit显示 */
    for(i = 0; i < size; i++)            /* 行循环 */
    {
        for(k = 0; k < row_size; k++)    /* 每行字节循环 */
        {
            for(j = 0; j < 8; j++)       /* 每字节bit循环 */
            {
                if(buff[i * row_size + k] & (0x80 >> j))  /* 亮点 */
                {
                    Lcd_DrawPoint(x + j + k * 8, y + i, font_color);
                }
                else                                      /* 暗点 */
                {
                    Lcd_DrawPoint(x + j + k * 8, y + i, bg_color);
                }
            }
        }
    }
}

/**
  * @brief LCD显示中英文混合字符串（字库版，从W25Q64读取）
  * @param  x               X轴起始坐标
  * @param  y               Y轴起始坐标
  * @param  font_color      字体颜色
  * @param  bg_color        背景颜色
  * @param  size            字体大小   16:16x16    24:24x24    32:32x32
  * @param  str             指向GB2312编码的字符串(以'\0'结尾)
  * @retval void
  * @note   自动识别ASCII(单字节)和汉字(双字节)
  *         ASCII字符宽=size/2, 汉字宽=size
  *         字符间距固定4像素
  */
void Lcd_ZikuStr(u16 x, u16 y, u16 font_color, u16 bg_color, u8 size, u8 *str)
{
    u16 offset_x = 0;                    /* x偏移累计 */
    u8 eng_width = 0;                    /* 英文字符宽度 */
    u8 spacing = 4;                      /* 字符间距(像素) */

    /* 根据字号计算英文字符宽度 */
    eng_width = size / 2;                /* 16号:8, 24号:12, 32号:16 */

    /* 遍历字符串,自动识别ASCII和汉字 */
    while(*str != '\0')
    {
        if(*str < 0x80)                  /* ASCII字符(单字节) */
        {
            Lcd_ZikuEng(x + offset_x, y, font_color, bg_color, size, *str);
            offset_x += eng_width + spacing;
            str++;                       /* ASCII占1字节,指针+1 */
        }
        else                             /* 汉字(双字节,GB2312编码) */
        {
            Lcd_ZikuChi(x + offset_x, y, font_color, bg_color, size, str);
            offset_x += size + spacing;  /* 汉字宽=size */
            str += 2;                    /* 汉字占2字节,指针+2 */
        }
    }
}


u8 *my_string[] = {eng111, eng112, eng113, NULL};

u8 eng1[]={
0x00,0x00,0x00,0x10,0x10,0x18,0x28,0x28,0x24,0x3C,0x44,0x42,0x42,0xE7,0x00,0x00,/*"A",0*/
};
u8 eng111[]={
0x00,0x00,0x00,0xEE,0x6C,0x6C,0x6C,0x6C,0x6C,0x54,0x54,0x54,0x54,0xD6,0x00,0x00,/*"M",0*/
};
u8 eng112[]={
0x00,0x00,0x00,0x3E,0x08,0x08,0x08,0x08,0x08,0x08,0x08,0x08,0x08,0x08,0x88,0xF0,/*"J",0*/
};
u8 eng113[]={
0x00,0x00,0x00,0xEE,0x44,0x44,0x28,0x28,0x10,0x10,0x10,0x10,0x10,0x38,0x00,0x00,/*"Y",0*/
};

u8 eng2[]={
0x00,0x00,0x00,0x00,0x00,0x00,0x00,0x00,0x00,0x00,0x06,0x00,0x06,0x00,0x0A,0x00,
0x0B,0x00,0x09,0x00,0x09,0x00,0x11,0x00,0x11,0x80,0x10,0x80,0x1F,0x80,0x20,0xC0,
0x20,0xC0,0x20,0x40,0x40,0x40,0x40,0x60,0xF0,0xF0,0x00,0x00,0x00,0x00,0x00,0x00,/*"A",0*/
};

u8 eng3[]={
0x00,0x00,0x00,0x00,0x00,0x00,0x00,0x00,0x00,0x00,0x00,0x00,0x7F,0xE0,0x18,0x38,
0x18,0x18,0x18,0x0C,0x18,0x0C,0x18,0x0C,0x18,0x0C,0x18,0x0C,0x18,0x18,0x18,0x30,
0x1F,0xE0,0x18,0x18,0x18,0x0C,0x18,0x04,0x18,0x06,0x18,0x06,0x18,0x06,0x18,0x06,
0x18,0x06,0x18,0x0C,0x18,0x18,0x7F,0xF0,0x00,0x00,0x00,0x00,0x00,0x00,0x00,0x00,/*"B",0*/
};

u8 eng4[]={
0x00,0x00,0x00,0x00,0x00,0x00,0x00,0x00,0x00,0x00,0x00,0x00,0x00,0x00,0x00,0x00,
0x00,0x00,0x00,0x00,0x00,0x00,0x00,0x00,0x00,0x00,0x00,0x00,0x00,0x00,0x00,0x00,
0x00,0x00,0x00,0x00,0x00,0x00,0x00,0x00,0x00,0x00,0x00,0x00,0x00,0x03,0xFC,0x10,
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0x00,0x00,0x00,0x00,0x00,0x00,0x00,0x00,0x00,0x00,0x00,0x00,0x00,0x00,0x00,0x00,/*"C",0*/
};


u8 eng6[]={
0x00,0x00,0x00,0x10,0x10,0x18,0x28,0x28,0x24,0x3C,0x44,0x42,0x42,0xE7,0x00,0x00,/*"A",0*/
0x00,0x00,0x00,0x10,0x10,0x18,0x28,0x28,0x24,0x3C,0x44,0x42,0x42,0xE7,0x00,0x00,/*"A",0*/
0x00,0x00,0x00,0x10,0x10,0x18,0x28,0x28,0x24,0x3C,0x44,0x42,0x42,0xE7,0x00,0x00,/*"A",0*/
0x00,0x00,0x00,0x10,0x10,0x18,0x28,0x28,0x24,0x3C,0x44,0x42,0x42,0xE7,0x00,0x00,/*"A",0*/
};
u8 chi1[]={
0x00,0x08,0x01,0xFC,0x7E,0x10,0x22,0x10,0x11,0x20,0x7F,0xFE,0x42,0x02,0x82,0x04,0x7F,0xF8,0x04,0x00,0x07,0xF0,0x0A,0x10,
0x11,0x20,0x20,0xC0,0x43,0x30,0x1C,0x0E,/*"爱",0*/
};

u8 chi2[]={
0x00,0x10,0x00,0x78,0xF3,0xC0,0x90,0x40,0x90,0x40,0xF7,0xFC,0x92,0x48,0x92,0x48,0xF7,0xFE,0x92,0x48,0x92,0x48,0x97,0xFC,
0xF0,0x40,0x90,0x40,0x07,0xFC,0x00,0x00,/*"睡",0*/
};

u8 chi3[]={
0x22,0x08,0x11,0x10,0x00,0x20,0x7F,0xFE,0x40,0x02,0x80,0x04,0x1F,0xF0,0x10,0x10,0x11,0x10,0x11,0x10,0x11,0x10,0x12,0x90,
0x02,0x80,0x04,0x84,0x18,0x84,0x60,0x7C,/*"觉",0*/
};

u8 chi4[]={


0x00,0x00,0x00,0x00,0x00,0x00,0x00,0x00,0x00,0x00,0x00,0x00,0x00,0x00,0x00,0x00,
0x00,0x00,0x00,0x00,0x00,0x01,0x00,0x00,0x00,0x00,0x00,0x00,0x00,0x01,0xE0,0x00,
0x00,0x00,0x00,0x00,0x00,0x01,0xF8,0x00,0x00,0x00,0x00,0x60,0x00,0x01,0xF0,0x00,
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0x00,0x00,0x00,0x00,0x00,0x00,0x00,0x00,0x00,0x00,0x00,0x00,0x00,0x00,0x00,0x00,/*"财",0*/


};
u8 chi5[]={
0x00,0x10,0x01,0xF8,0x7E,0x00,0x02,0x00,0x02,0x00,0x03,0xF0,0x3E,0x00,0x02,0x00,0x02,0x00,0x03,0xFC,0xFE,0x00,0x02,0x00,
0x02,0x04,0x02,0x04,0x02,0x04,0x01,0xFC,/*"毛",0*/

};
u8 chi6[]={
0x00,0x00,0x7F,0xFC,0x04,0x40,0x24,0x48,0x14,0x50,0x04,0x40,0xFF,0xFE,0x00,0x00,0x1F,0xF0,0x10,0x10,0x10,0x10,0x1F,0xF0,
0x10,0x10,0x10,0x10,0x1F,0xF0,0x10,0x10,/*"晋",1*/

};
u8 chi7[]={
0x10,0x00,0x11,0xDC,0x90,0x44,0x55,0x54,0x58,0xCC,0x11,0x54,0xFC,0x00,0x28,0x48,0x28,0xFE,0x29,0x90,0x2A,0xFC,0x28,0x90,
0x2A,0xFC,0x4C,0x90,0x48,0xFE,0x80,0x80,/*"耀",2*/

};
